## zephyr-guest/boards/bzdos/bpi_m64_hv/board.yml
```yaml
board:
  name: bpi_m64_hv
  full_name: Banana Pi M64 (Allwinner A64) -- bzdOS EL2 hypervisor EL1 guest
  vendor: bzdos
  socs:
  - name: qemu_virt_arm64
```

## zephyr-guest/boards/bzdos/bpi_m64_hv_dual/board.yml
```yaml
board:
  name: bpi_m64_hv_dual
  full_name: Banana Pi M64 (Allwinner A64) -- bzdOS EL2 hypervisor EL1 guest, dual-guest CPU3 slice
  vendor: bzdos
  socs:
  - name: qemu_virt_arm64
```
