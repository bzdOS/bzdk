## CMakeLists.txt
```
# Copyright (c) 2026 bzdOS project
# SPDX-License-Identifier: Apache-2.0
#
# Minimal standalone heartbeat app for the bpi_m64_hv board (see
# ../boards/bzdos/bpi_m64_hv/). Deliberately does not use k_sleep()/any
# kernel timeout API: this board runs CONFIG_SYS_CLOCK_EXISTS=n for its
# first bring-up (see that board's Kconfig.defconfig for why), so all
# pacing here is k_busy_wait(), which works without a system tick.

cmake_minimum_required(VERSION 3.20.0)
find_package(Zephyr REQUIRED HINTS $ENV{ZEPHYR_BASE})
project(bpi_m64_hv_heartbeat)

target_sources(app PRIVATE src/main.c)
```

## prj.conf
```kconfig
# Minimal -- everything else (serial, console, tickless timer config) comes
# from the board's own defconfig/Kconfig.defconfig
# (boards/bzdos/bpi_m64_hv/).
CONFIG_PRINTK=y
```

## boards/qemu_cortex_a53.conf
```kconfig
# QEMU-only overlay to sanity-check app/src/main.c's *logic* (tickless
# busy-wait heartbeat loop, no k_sleep) standing entirely alone, with no
# hypervisor underneath: qemu_cortex_a53 has entirely different MMIO
# addresses (GICv3, PL011) than the real bpi_m64_hv board and is NOT a
# stand-in for it.
#
# CORRECTION, 2026-08-04: this comment used to say that a QEMU boot of the
# bpi_m64_hv build itself could not be meaningful, because no QEMU machine
# matches its MMIO map. That reasoning was wrong -- it assumed the guest's
# MMIO has to be answered by QEMU. It doesn't: UART0 is trap-emulated by the
# hypervisor and never reaches QEMU at all. The real bpi_m64_hv image boots
# unmodified under `make zephyr-qemu`; run ../../../zephyr-qemu-ci.sh and see
# ../../../docs/zephyr-guest.md. That is the stronger test, and this overlay
# is now only useful for testing the app in isolation from the hypervisor.
CONFIG_ARM_ARCH_TIMER=n
CONFIG_SYS_CLOCK_EXISTS=n
CONFIG_UART_INTERRUPT_DRIVEN=n
CONFIG_BUSYWAIT_CPU_LOOPS_PER_USEC=400
```

## src/main.c
```c
/*
 * Copyright (c) 2026 bzdOS project
 * SPDX-License-Identifier: Apache-2.0
 *
 * Minimal proof-of-life app for Zephyr as an alternate EL1 guest under the
 * bzdOS EL2 hypervisor (board: bpi_m64_hv). Deliberately does NOT depend on
 * any interrupt reaching this guest (no system tick, no shell, no k_sleep):
 * see boards/bzdos/bpi_m64_hv/Kconfig.defconfig for exactly why (the
 * hypervisor's virtual-timer/vgic plumbing is not wired into any
 * guest-boot path yet). Only two things are exercised here, both of which
 * work with zero guest-visible interrupts:
 *   - printk() over the polled ns16550 UART0 driver (bzdOS's vconsole.c
 *     trap-and-emulates every MMIO access synchronously, so "polling" from
 *     the guest's point of view is just normal trapped stores/loads).
 *   - k_busy_wait(), which on this board config compiles down to a plain
 *     calibrated spin loop (CONFIG_SYS_CLOCK_EXISTS=n --
 *     CONFIG_BUSYWAIT_CPU_LOOPS_PER_USEC-driven), not a timer peripheral.
 */
#include <zephyr/kernel.h>
#include <zephyr/sys/printk.h>

int main(void)
{
	/* CONFIG_BOARD, not a literal: this app is built for two boards that
	 * differ only in one devicetree node (bpi_m64_hv on real hardware,
	 * qemu_virt_hv under QEMU), and a hardcoded name here made a QEMU log
	 * claim to be the board it is standing in for. */
	printk("\r\nbzdOS/Zephyr: hello from EL1 (board: " CONFIG_BOARD ")\r\n");

	uint32_t beat = 0;

	for (;;) {
		printk("heartbeat %u\r\n", beat++);
		k_busy_wait(1000000); /* ~1s, per the board's (uncalibrated --
					* see Kconfig.defconfig) busy-loop
					* constant */
	}

	return 0;
}
```
